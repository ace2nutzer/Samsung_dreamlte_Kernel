## arch/arm64/configs/n950x_defconfig
```kconfig
CONFIG_WLAN_GREAT=y
# CONFIG_TOUCHSCREEN_SEC_TS is not set
CONFIG_TOUCHSCREEN_SEC_TS_Y661=y
CONFIG_INPUT_WACOM=y
CONFIG_EPEN_WACOM_W9018=y
CONFIG_CAMERA_CIS_3M3_OBJ=y
# CONFIG_CAMERA_DREAM is not set
CONFIG_CAMERA_GREAT=y
# CONFIG_OIS_USE_RUMBA_S4 is not set
CONFIG_OIS_USE_RUMBA_S6=y
CONFIG_PANEL_POC_2_0=y
# CONFIG_POC_DREAM is not set
# CONFIG_SENSORS_SSP_DREAM is not set
CONFIG_SENSORS_SSP_GREAT=y
# CONFIG_UFS_UN_18DIGITS is not set
CONFIG_UFS_UN_20DIGITS=y
```

## arch/arm64/configs/n950x_kor_defconfig
```kconfig
CONFIG_WLAN_REGION_CODE=200
CONFIG_WLAN_GREAT=y
# CONFIG_TOUCHSCREEN_SEC_TS is not set
CONFIG_TOUCHSCREEN_SEC_TS_Y661=y
CONFIG_INPUT_WACOM=y
CONFIG_EPEN_WACOM_W9018=y
CONFIG_CAMERA_CIS_3M3_OBJ=y
# CONFIG_CAMERA_DREAM is not set
CONFIG_CAMERA_GREAT=y
# CONFIG_OIS_USE_RUMBA_S4 is not set
CONFIG_OIS_USE_RUMBA_S6=y
CONFIG_TDMB=y
# CONFIG_TDMB_VENDOR_FCI is not set
# CONFIG_TDMB_VENDOR_INC is not set
CONFIG_TDMB_VENDOR_RAONTECH=y
# CONFIG_TDMB_MTV318 is not set
CONFIG_TDMB_MTV319=y
# CONFIG_TDMB_VENDOR_TELECHIPS is not set
# CONFIG_TDMB_QUALCOMM is not set
CONFIG_TDMB_SLSI=y
CONFIG_TDMB_SPI=y
# CONFIG_TDMB_EBI is not set
# CONFIG_TDMB_TSIF_SLSI is not set
# CONFIG_TDMB_TSIF_QC is not set
# CONFIG_TDMB_I2C is not set
CONFIG_TDMB_XTAL_FREQ=y
# CONFIG_TDMB_DEBUG is not set
# CONFIG_TDMB_ANT_DET is not set
# CONFIG_TDMB_VREG_SUPPORT is not set
CONFIG_PANEL_POC_2_0=y
# CONFIG_POC_DREAM is not set
# CONFIG_SENSORS_SSP_DREAM is not set
CONFIG_SENSORS_SSP_GREAT=y
# CONFIG_UFS_UN_18DIGITS is not set
CONFIG_UFS_UN_20DIGITS=y
```
