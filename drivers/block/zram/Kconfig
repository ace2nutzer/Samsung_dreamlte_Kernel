## drivers/block/zram/Kconfig
```kconfig
config ZRAM
	tristate "Compressed RAM block device support"
	depends on BLOCK && SYSFS && ZSMALLOC
	select LZ4_COMPRESS
	select LZ4_DECOMPRESS
	default n
	help
	  Creates virtual block devices called /dev/zramX (X = 0, 1, ...).
	  Pages written to these disks are compressed and stored in memory
	  itself. These disks allow very fast I/O and compression provides
	  good amounts of memory savings.

	  It has several use cases, for example: /tmp storage, use as swap
	  disks and maybe many more.

	  See zram.txt for more information.

config ZRAM_MIGRATION_SUPPORT
	bool "Support the migration of zsmalloc pages used by zRam"
	depends on ZRAM && ZSMALLOC && COMPACTION
	default n
	help
	  By supporting the migration of zsmalloc pages, the compaction can migrate
	  more pages (originally, only anon and fs pages) so that
	  the compaction success rate may increase.

config ZRAM_LZO_COMPRESS
	bool "Enable LZO algorithm support"
	depends on ZRAM
	select LZO_COMPRESS
	select LZO_DECOMPRESS
	default n
	help
	  This option enables LZO compression algorithm support. Compression
	  algorithm can be changed using `comp_algorithm' device attribute.
```

## sound/soc/samsung/abox/Kconfig
```kconfig
config SND_SOC_SAMSUNG_ABOX
	tristate "ASoC support for Samsung ABOX Audio"
	select REGMAP_MMIO
	select SND_SOC_COMPRESS
	help
	  Say Y or M if you want to add support for codecs attached to
	  the Samsung SoC ABOX interface. You will also need to
	  select the audio interfaces to support below.

config SND_SOC_SAMSUNG_ABOX_DEBUG
	tristate "ASoC debug support for Samsung ABOX Audio"
	depends on SND_SOC_SAMSUNG_ABOX
	help
	  Say Y or M if you want debug info for ABOX.

config SEC_SND_ADAPTATION
	tristate "Samsung ABOX Adaptation for Audio"
	depends on SND_SOC_SAMSUNG_ABOX
	help
	  Say Y or M if you want to add support for external devices attached to
	  the Samsung SoC ABOX interface. You will also need to
	  select the audio interfaces to support below.
```
